## west.yml
```yaml
manifest:
  version: 0.7
 
  defaults:
    remote: zephyrproject
  remotes:
    - name: zephyrproject
      url-base: https://github.com/sageve
  projects:
    - name: zephyr
      repo-path: zephyr
      revision: main
      import:
        path-prefix: deps
        name-allowlist:
          - cmsis
          - hal_stm32
      path: zephyr
      revision: hs-usb
  self:
    path: app
```
